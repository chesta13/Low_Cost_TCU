/**
 * @cliArgs --device "MSPM0G350X" --part "Default" --package "LQFP-64(PM)" --product "mspm0_sdk@2.06.00.06"
 * @versions {"tool":"1.25.0+4268"}
 */

/**
 * Import the modules used in this configuration.
 */
const ADC12  = scripting.addModule("/ti/driverlib/ADC12", {}, false);
const ADC121 = ADC12.addInstance();
const GPIO   = scripting.addModule("/ti/driverlib/GPIO", {}, false);
const GPIO1  = GPIO.addInstance();
const I2C    = scripting.addModule("/ti/driverlib/I2C", {}, false);
const I2C1   = I2C.addInstance();
const SPI    = scripting.addModule("/ti/driverlib/SPI", {}, false);
const SPI1   = SPI.addInstance();
const SYSCTL = scripting.addModule("/ti/driverlib/SYSCTL");
const TIMER  = scripting.addModule("/ti/driverlib/TIMER", {}, false);
const TIMER1 = TIMER.addInstance();
const UART   = scripting.addModule("/ti/driverlib/UART", {}, false);
const UART1  = UART.addInstance();

/**
 * Write custom configuration values to the imported modules.
 */
ADC121.$name               = "ADC12_0";
ADC121.adcPin0Config.$name = "ti_driverlib_gpio_GPIOPinGeneric8";

const Board = scripting.addModule("/ti/driverlib/Board", {}, false);

GPIO1.$name                   = "GPIO_GRP_0";
GPIO1.port                    = "PORTA";
GPIO1.portSegment             = "Lower";
GPIO1.associatedPins[0].$name = "PIN_0";

I2C1.$name              = "I2C_0";
I2C1.sdaPinConfig.$name = "ti_driverlib_gpio_GPIOPinGeneric6";
I2C1.sclPinConfig.$name = "ti_driverlib_gpio_GPIOPinGeneric7";

SPI1.$name               = "SPI_0";
SPI1.sclkPinConfig.$name = "ti_driverlib_gpio_GPIOPinGeneric2";
SPI1.mosiPinConfig.$name = "ti_driverlib_gpio_GPIOPinGeneric3";
SPI1.misoPinConfig.$name = "ti_driverlib_gpio_GPIOPinGeneric4";
SPI1.cs0PinConfig.$name  = "ti_driverlib_gpio_GPIOPinGeneric5";

SYSCTL.forceDefaultClkConfig = true;

TIMER1.$name = "TIMER_0";

UART1.$name             = "UART_0";
UART1.txPinConfig.$name = "ti_driverlib_gpio_GPIOPinGeneric0";
UART1.rxPinConfig.$name = "ti_driverlib_gpio_GPIOPinGeneric1";

/**
 * Pinmux solution for unlocked pins/peripherals. This ensures that minor changes to the automatic solver in a future
 * version of the tool will not impact the pinmux you originally saw.  These lines can be completely deleted in order to
 * re-solve from scratch.
 */
ADC121.peripheral.$suggestSolution           = "ADC0";
ADC121.peripheral.adcPin0.$suggestSolution   = "PA27";
Board.peripheral.$suggestSolution            = "DEBUGSS";
Board.peripheral.swclkPin.$suggestSolution   = "PA20";
Board.peripheral.swdioPin.$suggestSolution   = "PA19";
GPIO1.associatedPins[0].pin.$suggestSolution = "PA13";
I2C1.peripheral.$suggestSolution             = "I2C0";
I2C1.peripheral.sdaPin.$suggestSolution      = "PA28";
I2C1.peripheral.sclPin.$suggestSolution      = "PA31";
SPI1.peripheral.$suggestSolution             = "SPI0";
SPI1.peripheral.sclkPin.$suggestSolution     = "PA11";
SPI1.peripheral.mosiPin.$suggestSolution     = "PA14";
SPI1.peripheral.misoPin.$suggestSolution     = "PA10";
SPI1.peripheral.cs0Pin.$suggestSolution      = "PA2";
SYSCTL.peripheral.$suggestSolution           = "SYSCTL";
TIMER1.peripheral.$suggestSolution           = "TIMA0";
UART1.peripheral.$suggestSolution            = "UART0";
UART1.peripheral.rxPin.$suggestSolution      = "PA1";
UART1.peripheral.txPin.$suggestSolution      = "PA0";
